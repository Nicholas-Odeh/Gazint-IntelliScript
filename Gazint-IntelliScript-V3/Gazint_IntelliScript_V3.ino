// https://github.com/Nicholas-Odeh/Gazint-IntelliScript
// Gazint-IntelliScript-V2
// Made by Nicholas Odeh, for IT automation
//
// Target hardware: Arduino Pro Micro (ATmega32u4), SSD1306 128x32 I2C OLED
// on SDA=2 / SCL=3, three (or four) momentary push buttons.
//
// v3 changes from the original release:
//  - Switched from the stock Keyboard/Mouse libraries to HID-Project's
//    BootKeyboard/BootMouse.
//
//  - Buttons rewired in software to INPUT_PULLUP (button -> GND), so no
//    external pull resistors are required and unconnected/miswired pins
//    default safely to "not pressed" instead of floating.
//
//  - Added real edge-triggered debouncing.
//
//  - Fixed a silent integer-overflow bug: Mouse.move()/BootMouse.move()
//    take a signed char (-128..127). 
//
//  - Fixed "D:\Dell BIOS" -> "D:\\Dell BIOS".
//
//  - Switched to the explicit Adafruit_SSD1306(width, height, &Wire, reset)
//    constructor.

//  - Added an optional 4th button that opens a disk-partitioning helper
//    (Shift+F10 -> diskpart -> list disk) for technicians who need to wipe
//    a drive before installing Windows. 
//
// KNOWN LIMITATIONS:
//  - USB-C: the ATmega32u4 only speaks USB 2.0 Full-Speed signaling.
//
//  - This sketch cannot remove the USB CDC (virtual serial) interface.


#include <Wire.h>
#include <Adafruit_GFX.h>
#include <Adafruit_SSD1306.h>
#include <HID-Project.h>   // BootKeyboard / BootMouse (BIOS-compatible HID)

// ============================================================================
// USER CONFIGURATION -- edit only this block for normal setup/customization.
// ============================================================================

// Uncomment to enable USB-CDC serial debug logging. Leave commented out for
// field deployment: it adds flash/runtime overhead and is not needed for the
// device to function.
// #define DEBUG_SERIAL

// --- OLED display (SSD1306, I2C) ---
#define SCREEN_WIDTH   128
#define SCREEN_HEIGHT  32
#define OLED_RESET     4      // Pro Micro OLED shields commonly reset on D4
#define OLED_I2C_ADDR  0x3C   // pro micro OLED pins: 2 (SDA) & 3 (SCL)

// --- Button pins ---
// Wiring: each button connects the pin to GND. No external resistor needed;
// internal pull-ups are enabled in setup(). A disconnected pin reads HIGH
// ("not pressed"), so a wiring mistake fails safe instead of auto-firing.
const uint8_t buttonAPin = 8;   // Admin pass-key
const uint8_t buttonBPin = 7;   // BIOS driver location
const uint8_t buttonCPin = 10;  // BIOS key into Windows install
const uint8_t buttonDPin = 9;   // Disk wipe/reformat helper (diskpart)

// --- Timing ---
const uint16_t DEBOUNCE_MS       = 30;  // ignore contact bounce shorter than this
const uint16_t KEY_STEP_DELAY_MS = 15;  // delay between HID actions in a macro
const int8_t   MOUSE_JIGGLE_PX   = 100; // must stay within int8_t range (-128..127)
const uint16_t MOUSE_JIGGLE_DELAY_MS = 120;

// --- Secrets: fill these in before flashing a device for deployment. ---
// SECURITY WARNING: this device types these values in plaintext whenever the
// matching button is pressed, and they are stored in plaintext flash on the
// board. Anyone with physical possession of a flashed board can read or
// replay them (e.g. by dumping flash, or simply pressing the buttons). Treat
// a lost or stolen board as a compromise of every credential below and
// rotate them immediately. Do not reuse a domain admin password here if you
// can avoid it -- prefer a scoped local/service account with the minimum
// rights needed for imaging.
const char* ADMIN_PASSKEY     = "yourkeyhere";
const char* BIOS_DRIVER_PATH  = "D:\\Dell BIOS";
const char* WINDOWS_BIOS_KEY  = "Your BIOS Key";

// ============================================================================
// END USER CONFIGURATION
// ============================================================================

Adafruit_SSD1306 display(SCREEN_WIDTH, SCREEN_HEIGHT, &Wire, OLED_RESET);
bool displayOk = false;

#ifdef DEBUG_SERIAL
  #define DEBUG_PRINTLN(x) Serial.println(x)
#else
  #define DEBUG_PRINTLN(x)
#endif

// Types used in function signatures below are declared here, near the top of
// the file. The Arduino build system auto-generates forward prototypes for
// every function defined in this .ino and inserts them immediately after the
// last #include, before anything else -- so any custom type (enum/struct)
// used as a parameter must be defined above this point, or the generated
// prototype won't compile.
enum Screen : uint8_t { SCREEN_NONE, SCREEN_IDLE, SCREEN_A, SCREEN_B, SCREEN_C, SCREEN_D };

struct Button {
  uint8_t pin;
  bool lastReading;
  bool stableState;
  unsigned long lastChangeMs;
};

// change the bitmaps to change the images shown on each screen
// bitmap generator: https://javl.github.io/image2cpp/

const unsigned char myBitmap[] PROGMEM = {
  0x77, 0x77, 0x77, 0x77, 0x57, 0x77, 0x77, 0x77, 0x77, 0x77, 0x77, 0x75, 0x77, 0x77, 0x77, 0x77,
  0xff, 0xff, 0xff, 0xe3, 0xc7, 0xff, 0xe3, 0xf3, 0xff, 0xff, 0xff, 0xf1, 0xf3, 0xff, 0xff, 0xff,
  0xfd, 0x5f, 0xff, 0x45, 0x07, 0xff, 0xd4, 0xc7, 0xff, 0xf5, 0xff, 0xd4, 0x43, 0xff, 0xfd, 0x7d,
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  0xff, 0xff, 0xff, 0xff, 0xff, 0xff, 0xff, 0xff, 0xff, 0xff, 0xff, 0xff, 0xff, 0xff, 0xff, 0xff
};

const unsigned char myBitmap2[] PROGMEM = {
  0x55, 0x55, 0x55, 0x55, 0x55, 0x55, 0x55, 0x55, 0x55, 0x55, 0x55, 0x55, 0x55, 0x55, 0x55, 0x55,
  0xaa, 0xaa, 0xaa, 0xaa, 0xaa, 0xaa, 0xaa, 0xaa, 0xa0, 0xa0, 0xaa, 0xaa, 0xaa, 0xaa, 0x0a, 0x0a,
  0x55, 0x55, 0x55, 0x55, 0x55, 0x55, 0x55, 0x55, 0x50, 0x54, 0x55, 0x55, 0x55, 0x55, 0x55, 0x15,
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  0xaa, 0xaa, 0xaa, 0xaa, 0xaa, 0xaa, 0xaa, 0xaa, 0xaa, 0xaa, 0xaa, 0xaa, 0xaa, 0xaa, 0xaa, 0xaa
};

const unsigned char myBitmap3[] PROGMEM = {
  0xff, 0xff, 0xff, 0xff, 0xff, 0xff, 0xff, 0xff, 0xff, 0xff, 0x7f, 0xff, 0xff, 0xff, 0xff, 0xff,
  0xff, 0xff, 0xff, 0xff, 0xff, 0xf7, 0xf7, 0xfb, 0xf7, 0xfe, 0x3f, 0xff, 0xff, 0xff, 0xff, 0xff,
  0xff, 0xff, 0xff, 0xff, 0xff, 0xf3, 0xe7, 0xf9, 0xe7, 0xfc, 0x3e, 0xff, 0xff, 0xff, 0xff, 0xff,
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  0xff, 0xff, 0xff, 0xff, 0xff, 0xff, 0xff, 0xff, 0xff, 0xff, 0xff, 0xff, 0xff, 0xff, 0xff, 0xff
};

const unsigned char myBitmap4[] PROGMEM = {
  0x00, 0x00, 0x00, 0x00, 0x00, 0x00, 0x00, 0x00, 0x00, 0x00, 0x00, 0x00, 0x00, 0x00, 0x00, 0x00,
  0x00, 0x00, 0x00, 0x00, 0x00, 0x00, 0x00, 0x00, 0x00, 0x00, 0x00, 0x00, 0x00, 0x00, 0x00, 0x00,
  0x00, 0x00, 0x00, 0x00, 0x00, 0x00, 0x00, 0x00, 0x00, 0x00, 0x00, 0x00, 0x00, 0x00, 0x00, 0x00,
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  0x00, 0x00, 0x00, 0x00, 0x00, 0x00, 0x00, 0x00, 0x00, 0x00, 0x00, 0x00, 0x00, 0x00, 0x00, 0x00
};

// NOTE: myBitmap5 is byte-for-byte identical to myBitmap4 in the original
// source (it is a duplicate, not a distinct image) and was not referenced by
// any button in the original sketch either. It is kept here unchanged so no
// existing asset is deleted; the new Button D screen below uses a text
// label instead of a placeholder bitmap, since inventing new bitmap pixel
// data with no source image to convert would just be fabricated content.
// Feel free to regenerate this array with a real image via
// https://javl.github.io/image2cpp/ and wire it into runDiskWipeHelperMacro()
// if you want a custom graphic for that screen.
const unsigned char myBitmap5[] PROGMEM = {
  0x00, 0x00, 0x00, 0x00, 0x00, 0x00, 0x00, 0x00, 0x00, 0x00, 0x00, 0x00, 0x00, 0x00, 0x00, 0x00,
  0x00, 0x00, 0x00, 0x00, 0x00, 0x00, 0x00, 0x00, 0x00, 0x00, 0x00, 0x00, 0x00, 0x00, 0x00, 0x00,
  0x00, 0x00, 0x00, 0x00, 0x00, 0x00, 0x00, 0x00, 0x00, 0x00, 0x00, 0x00, 0x00, 0x00, 0x00, 0x00,
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  0x00, 0x00, 0x00, 0x00, 0x00, 0x00, 0x00, 0x00, 0x00, 0x00, 0x00, 0x00, 0x00, 0x00, 0x00, 0x00
};

// ---------------------------------------------------------------------------
// Debounced, edge-triggered button state
// ---------------------------------------------------------------------------
Button buttons[] = {
  { buttonAPin, HIGH, HIGH, 0 },
  { buttonBPin, HIGH, HIGH, 0 },
  { buttonCPin, HIGH, HIGH, 0 },
  { buttonDPin, HIGH, HIGH, 0 },
};
const uint8_t NUM_BUTTONS = sizeof(buttons) / sizeof(buttons[0]);

// Returns true exactly once per physical press (LOW = pressed, since pins
// use INPUT_PULLUP), after the signal has been stable for DEBOUNCE_MS. This
// replaces the original level-triggered check, which re-ran a button's
// entire macro on every ~50ms loop iteration for as long as it was held.
bool pressedEdge(Button &b) {
  bool reading = digitalRead(b.pin);
  if (reading != b.lastReading) {
    b.lastChangeMs = millis();
    b.lastReading = reading;
  }
  if ((millis() - b.lastChangeMs) > DEBOUNCE_MS && b.stableState != reading) {
    b.stableState = reading;
    if (b.stableState == LOW) return true;
  }
  return false;
}

// ---------------------------------------------------------------------------
// OLED helpers -- only push a new frame over I2C when the screen actually
// changes, instead of redrawing the same bitmap on every loop iteration.
// ---------------------------------------------------------------------------
Screen currentScreen = SCREEN_NONE;

void showBitmapScreen(Screen s, const uint8_t* bitmap) {
  if (!displayOk || s == currentScreen) return;
  display.clearDisplay();
  display.drawBitmap(0, 0, bitmap, SCREEN_WIDTH, SCREEN_HEIGHT, WHITE);
  display.display();
  currentScreen = s;
}

void showTextScreen(Screen s, const char* line1, const char* line2) {
  if (!displayOk || s == currentScreen) return;
  display.clearDisplay();
  display.setTextSize(1);
  display.setTextColor(WHITE);
  display.setCursor(0, 0);
  display.println(line1);
  if (line2 != nullptr) display.println(line2);
  display.display();
  currentScreen = s;
}

// ---------------------------------------------------------------------------
// Button macros
// ---------------------------------------------------------------------------

// Admin PASS-KEY hotkey (pin A = pin 8)
void runAdminPassKeyMacro() {
  DEBUG_PRINTLN("Button A pressed");
  showBitmapScreen(SCREEN_A, myBitmap2);
  BootMouse.click(MOUSE_LEFT);
  delay(KEY_STEP_DELAY_MS);
  BootKeyboard.print(ADMIN_PASSKEY); // sensitive: see SECURITY WARNING above
  delay(KEY_STEP_DELAY_MS);
  BootKeyboard.write(KEY_RETURN);
}

// BIOS driver location hotkey (pin B = pin 7)
void runBiosDriverMacro() {
  DEBUG_PRINTLN("Button B pressed");
  showBitmapScreen(SCREEN_B, myBitmap3);
  delay(25);
  BootMouse.click(MOUSE_LEFT); // left-click first to make sure the active window has focus
  BootKeyboard.press(KEY_LEFT_GUI);
  BootKeyboard.press('r');
  delay(KEY_STEP_DELAY_MS);
  BootKeyboard.releaseAll();
  delay(KEY_STEP_DELAY_MS);
  BootKeyboard.print(BIOS_DRIVER_PATH);
  delay(KEY_STEP_DELAY_MS);
  BootKeyboard.write(KEY_RETURN);
}

// BIOS key into Windows Install hotkey (pin C = pin 10)
void runWindowsBiosKeyMacro() {
  DEBUG_PRINTLN("Button C pressed");
  showBitmapScreen(SCREEN_C, myBitmap);
  delay(KEY_STEP_DELAY_MS);
  BootKeyboard.write(KEY_DOWN_ARROW);
  BootKeyboard.write(KEY_RETURN);
  BootKeyboard.print(WINDOWS_BIOS_KEY);
  BootKeyboard.write(KEY_RETURN);
  delay(20);
  // Jiggle the mouse (e.g. to keep a screen/session from timing out during a
  // long unattended install). Distance is kept within int8_t range -- the
  // original code passed +-200 here, which silently overflows a signed char
  // and moves the wrong distance/direction.
  BootMouse.move(-MOUSE_JIGGLE_PX, 0); delay(MOUSE_JIGGLE_DELAY_MS);
  BootMouse.move(MOUSE_JIGGLE_PX, 0);  delay(MOUSE_JIGGLE_DELAY_MS);
  BootMouse.move(0, -MOUSE_JIGGLE_PX / 5); delay(MOUSE_JIGGLE_DELAY_MS);
  BootMouse.move(0, MOUSE_JIGGLE_PX / 5);  delay(MOUSE_JIGGLE_DELAY_MS);
}

// Disk wipe/reformat helper hotkey (pin D = pin 9)
// Opens a command console and starts diskpart, then lists disks and STOPS.
// The destructive "select disk N" / "clean" commands are intentionally left
// for the technician to type by hand after reading the disk list, so this
// macro can never wipe the wrong drive if disk numbering differs from what
// was assumed (extra USB media plugged in, different drive order, etc.).
void runDiskWipeHelperMacro() {
  DEBUG_PRINTLN("Button D pressed");
  showTextScreen(SCREEN_D, "DISKPART", "Listing disks...");
  // Shift+F10 opens a command prompt directly inside Windows Setup/WinPE,
  // where there is no taskbar/Explorer for a Win+R "Run" dialog to work.
  BootKeyboard.press(KEY_LEFT_SHIFT);
  BootKeyboard.press(KEY_F10);
  delay(KEY_STEP_DELAY_MS);
  BootKeyboard.releaseAll();
  delay(500); // the cmd.exe console needs time to open before it can accept input
  BootKeyboard.print("diskpart");
  BootKeyboard.write(KEY_RETURN);
  delay(800); // diskpart.exe starts noticeably slower than cmd.exe itself
  BootKeyboard.print("list disk");
  BootKeyboard.write(KEY_RETURN);
  // Intentionally stops here -- see comment above.
}

// ---------------------------------------------------------------------------
void setup() {
#ifdef DEBUG_SERIAL
  Serial.begin(9600);
#endif

  pinMode(buttonAPin, INPUT_PULLUP);
  pinMode(buttonBPin, INPUT_PULLUP);
  pinMode(buttonCPin, INPUT_PULLUP);
  pinMode(buttonDPin, INPUT_PULLUP);

  displayOk = display.begin(SSD1306_SWITCHCAPVCC, OLED_I2C_ADDR);
  if (displayOk) {
    display.clearDisplay();
    display.display();
  }
  // If the OLED fails to initialize (e.g. a wiring fault), keyboard/mouse
  // automation -- the tool's actual job -- still runs; only the status
  // screen is lost. See showBitmapScreen()/showTextScreen()'s displayOk guard.

  BootKeyboard.begin();
  BootMouse.begin();
}

void loop() {
  showBitmapScreen(SCREEN_IDLE, myBitmap4); // no-op once already idle

  for (uint8_t i = 0; i < NUM_BUTTONS; i++) {
    if (pressedEdge(buttons[i])) {
      switch (i) {
        case 0: runAdminPassKeyMacro();     break;
        case 1: runBiosDriverMacro();       break;
        case 2: runWindowsBiosKeyMacro();   break;
        case 3: runDiskWipeHelperMacro();   break;
      }
      currentScreen = SCREEN_NONE; // force the idle screen to redraw next loop
    }
  }
}
