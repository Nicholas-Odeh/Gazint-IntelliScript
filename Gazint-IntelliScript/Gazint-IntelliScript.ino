//Made by Nicholas Odeh, for IT automation
#include <SPI.h>
#include <Wire.h>
#include <Adafruit_GFX.h>
#include <Adafruit_SSD1306.h>
#include <Keyboard.h>
#include <Mouse.h>
#define OLED_RESET 4
#define pinA 8
#define pinB 7
#define pinC 6
#define pinD 10
Adafruit_SSD1306 display(OLED_RESET);
//pro mciro oled pins: 2(SDA) & 3(SCL)

//change this to change images for your use case.
const unsigned char myBitmap[] PROGMEM = {
  0x77, 0x77, 0x77, 0x77, 0x57, 0x77, 0x77, 0x77, 0x77, 0x77, 0x77, 0x75, 0x77, 0x77, 0x77, 0x77,
  0xff, 0xff, 0xff, 0xe3, 0xc7, 0xff, 0xe3, 0xf3, 0xff, 0xff, 0xff, 0xf1, 0xf3, 0xff, 0xff, 0xff,
  0xfd, 0x5f, 0xff, 0x45, 0x07, 0xff, 0xd4, 0xc7, 0xff, 0xf5, 0xff, 0xd4, 0x43, 0xff, 0xfd, 0x7d,
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  0xff, 0xff, 0xff, 0xff, 0xff, 0xff, 0xff, 0xff, 0xff, 0xff, 0xff, 0xff, 0xff, 0xff, 0xff, 0xff
};

const unsigned char myBitmap2[] PROGMEM = {
  0x55, 0x55, 0x55, 0x55, 0x55, 0x55, 0x55, 0x55, 0x55, 0x55, 0x55, 0x55, 0x55, 0x55, 0x55, 0x55,
  0xaa, 0xaa, 0xaa, 0xaa, 0xaa, 0xaa, 0xaa, 0xaa, 0xa0, 0xa0, 0xaa, 0xaa, 0xaa, 0xaa, 0x0a, 0x0a,
  0x55, 0x55, 0x55, 0x55, 0x55, 0x55, 0x55, 0x55, 0x50, 0x54, 0x55, 0x55, 0x55, 0x55, 0x55, 0x15,
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  0xaa, 0xaa, 0xaa, 0xaa, 0xaa, 0xaa, 0xaa, 0xaa, 0xaa, 0xaa, 0xaa, 0xaa, 0xaa, 0xaa, 0xaa, 0xaa
};

const unsigned char myBitmap3[] PROGMEM = {
	0xff, 0xff, 0xff, 0xff, 0xff, 0xff, 0xff, 0xff, 0xff, 0xff, 0x7f, 0xff, 0xff, 0xff, 0xff, 0xff, 
	0xff, 0xff, 0xff, 0xff, 0xff, 0xf7, 0xf7, 0xfb, 0xf7, 0xfe, 0x3f, 0xff, 0xff, 0xff, 0xff, 0xff, 
	0xff, 0xff, 0xff, 0xff, 0xff, 0xf3, 0xe7, 0xf9, 0xe7, 0xfc, 0x3e, 0xff, 0xff, 0xff, 0xff, 0xff, 
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	0xff, 0xff, 0xff, 0xff, 0xff, 0xff, 0xff, 0xff, 0xff, 0xff, 0xff, 0xff, 0xff, 0xff, 0xff, 0xff
};

const unsigned char myBitmap4[] PROGMEM = {
	0x00, 0x00, 0x00, 0x00, 0x00, 0x00, 0x00, 0x00, 0x00, 0x00, 0x00, 0x00, 0x00, 0x00, 0x00, 0x00, 
	0x00, 0x00, 0x00, 0x00, 0x00, 0x00, 0x00, 0x00, 0x00, 0x00, 0x00, 0x00, 0x00, 0x00, 0x00, 0x00, 
	0x00, 0x00, 0x00, 0x00, 0x00, 0x00, 0x00, 0x00, 0x00, 0x00, 0x00, 0x00, 0x00, 0x00, 0x00, 0x00, 
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	0x00, 0x00, 0x00, 0x00, 0x00, 0x00, 0x00, 0x00, 0x00, 0x00, 0x00, 0x00, 0x00, 0x00, 0x00, 0x00
};


const unsigned char myBitmap5[] PROGMEM = {
	0x00, 0x00, 0x00, 0x00, 0x00, 0x00, 0x00, 0x00, 0x00, 0x00, 0x00, 0x00, 0x00, 0x00, 0x00, 0x00, 
	0x00, 0x00, 0x00, 0x00, 0x00, 0x00, 0x00, 0x00, 0x00, 0x00, 0x00, 0x00, 0x00, 0x00, 0x00, 0x00, 
	0x00, 0x00, 0x00, 0x00, 0x00, 0x00, 0x00, 0x00, 0x00, 0x00, 0x00, 0x00, 0x00, 0x00, 0x00, 0x00, 
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	0x00, 0x00, 0x00, 0x00, 0x00, 0x00, 0x00, 0x00, 0x00, 0x00, 0x00, 0x00, 0x00, 0x00, 0x00, 0x00
};


void setup() {

  pinMode(pinA, INPUT_PULLUP);                //setting up internal pullup resitor
  display.begin(SSD1306_SWITCHCAPVCC, 0x3C);  // 0x3c is the I2C address
  display.clearDisplay();
  Keyboard.begin();  // Initialize the keyboard
  Mouse.begin();     // Initialize Mouse library
}

void loop() {
  display.display();
  display.drawBitmap(0, 0, myBitmap2, 128, 32, WHITE); //Admin Pass Hotkey.
  display.display();
  delay(200);

//Admin Pass Hotkey. 
  if (digitalRead(pinA) == LOW) { //pinA = pin 8
    Serial.println("Button A pressed"); // to make sure key is funtional
    display.clearDisplay();
    display.drawBitmap(0, 0, myBitmap4, 128, 32, WHITE);
    display.display();
    delay(100);
    Mouse.click(MOUSE_LEFT);  // Perform a right-click
    display.display();
    delay(100);
    Keyboard.print("Your BIOS Key");  // Corrected with a semicolon
    delay(100);
    Keyboard.write(KEY_RETURN);
    delay(100);
    while (digitalRead(pinA) == LOW);  // Wait for button release to avoid repeated messages
    delay(50);
    display.clearDisplay();
  }


//BIOS DRIVER LOCATION 7400 Hotkey
    if (digitalRead(pinB) == LOW) { //pinB = pin 7
    Serial.println("Button B pressed");
    display.clearDisplay();
    display.drawBitmap(0, 0, myBitmap3, 128, 32, WHITE);
    display.display();
    delay(100);
   // Mouse.click(MOUSE_LEFT);  // Perform a right-click
    Keyboard.press(KEY_LEFT_GUI); // Press the Windows key
    Keyboard.press('r');          // Press the 'R' key Write what you want here! 
    delay(100);                   
    Keyboard.releaseAll();        // Release all keys
    display.display();
    delay(100);
    Keyboard.print("D:/Dell BIOS/Latitude 7400");  // Bios driver location
    delay(100);
    Keyboard.write(KEY_RETURN);
    delay(100);
    while (digitalRead(pinB) == LOW);  // Wait for button release to avoid repeated messages
    delay(50);
    display.clearDisplay();


  }



  //BIOS Windows Install Hotkey
    if (digitalRead(pinC) == LOW) { //pinC = pin 6
     Serial.println("Button C pressed");
    display.clearDisplay();
    display.drawBitmap(0, 0, myBitmap, 128, 32, WHITE);
    display.display();
    delay(100);
    Keyboard.write(KEY_DOWN_ARROW);
    Keyboard.write(KEY_RETURN);
    Keyboard.print("Your BIOS Key");
    Keyboard.write(KEY_RETURN);

//more code for mouse movement automation can go here
//more code for mouse movement automation can go here
    delay(100);
    while (digitalRead(pinC) == LOW);  // Wait for button release to avoid repeated messages
    delay(50);
    display.clearDisplay();


  }

 
  


}
